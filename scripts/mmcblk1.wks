## scripts/mmcblk1.wks
```
# Description: Creates a partitioned SD card image. Boot files
# are located in the first vfat partition. Rootfs will be in second ext4 partition.

part /boot --source bootimg-partition --ondisk mmcblk1 --fstype=vfat --label boot --active --align 4 --fixed-size 2G
part / --source rootfs --ondisk mmcblk1 --fstype=ext4 --label root --align 4 --fixed-size 4G
```
